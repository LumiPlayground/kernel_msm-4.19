/dts-v1/;

#include "qm215.dtsi"
#include "qm215-pm8916.dtsi"
#include "qm215-audio.dtsi"

#include "vin8937/sugarcane.dtsi"
#include "vin8937/vin8937.dtsi"

/ {
	model = "Qualcomm Technologies, Inc. QM215";
	compatible = "qcom,qm215";
	qcom,pmic-name = "PM8916";
};
